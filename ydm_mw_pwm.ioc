# file: ydm_mw_pwm.ioc
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Mcu.Family=STM32F3
Mcu.Name=STM32F334C(4-6-8)Tx
Mcu.Package=LQFP48
NVIC.PriorityGroup=NVIC_PRIORITYGROUP_4
PF0\ /\ OSC_IN.Mode=HSE-External-Oscillator
PF0\ /\ OSC_IN.Signal=RCC_OSC_IN
PF1\ /\ OSC_OUT.Mode=HSE-External-Oscillator
PF1\ /\ OSC_OUT.Signal=RCC_OSC_OUT
ProjectManager.HeapSize=0x200
ProjectManager.StackSize=0x400
ProjectManager.TargetToolchain=MDK-ARM V5.27
RCC.AHBFreq_Value=72000000
RCC.APB1CLKDivider=RCC_HCLK_DIV2
RCC.APB1Freq_Value=36000000
RCC.APB1TimFreq_Value=72000000
RCC.APB2Freq_Value=72000000
RCC.APB2TimFreq_Value=72000000
RCC.CortexFreq_Value=72000000
RCC.HCLKFreq_Value=72000000
RCC.HSE_VALUE=8000000
RCC.HSI_VALUE=8000000
RCC.PLLMUL=RCC_PLL_MUL9
RCC.PLLSourceVirtual=RCC_PLLSOURCE_HSE
RCC.SYSCLKFreq_VALUE=72000000
RCC.SYSCLKSourceVirtual=RCC_SYSCLKSOURCE_PLLCLK
board=custom

// file: Core/Src/main.c
/* USER CODE BEGIN Header */
/**
  ******************************************************************************
  * @file           : main.c
  * @brief          : Main program body
  ******************************************************************************
  * @attention
  *
  * <h2><center>&copy; Copyright (c) 2021 STMicroelectronics.
  * All rights reserved.</center></h2>
  *
  * This software component is licensed by ST under BSD 3-Clause license,
  * the "License"; You may not use this file except in compliance with the
  * License. You may obtain a copy of the License at:
  *                        opensource.org/licenses/BSD-3-Clause
  *
  ******************************************************************************
  */
/* USER CODE END Header */

#include "main.h"
#include "i2c.h"

/* USER CODE BEGIN PD */
#define HIGH_IDEAL_COUNT 3686
#define LOW_IDEAL_COUNT 0
/* USER CODE END PD */

void SystemClock_Config(void);
static void MX_GPIO_Init(void);
/* USER CODE BEGIN PFP */
static void GPIO_Init(void);
static void TIM_Init(void);
static void DMA_Init(void);
static void ADC_Init(void);
static void PGA_Init(void);
static void DAC_Init(void);
static void UART_Init(void);
static void Calibrate_Init(void);
void Calibrate(void);
void TIM2_IRQHandler(void);
void TIM3_IRQHandler(void);
/* USER CODE END PFP */

/* USER CODE BEGIN 0 */
__IO uint16_t ADC2ConvertedVault[64];				//定义储存数组
uint32_t	OverSampling_15bit;								//15位过采样值
uint32_t 	OverSampling_20bit;								//20位过采样值
uint16_t	Avg_H_Count;											//90%样本平均值
uint16_t	Avg_L_Count;											//0%样本平均值
uint16_t	Actual_Gain;											//实际增益值
uint16_t	Actual_Offset;										//实际截止值
int TimeBase = 0;														//秒级时基
int Calibrate_Status = 0;
/* USER CODE END 0 */

int main(void)
{

  /* MCU Configuration--------------------------------------------------------*/

  /* Reset of all peripherals, Initializes the Flash interface and the Systick. */
  HAL_Init();

  /* Configure the system clock */
  SystemClock_Config();

  /* Initialize all configured peripherals */
  MX_GPIO_Init();

	/* USER CODE BEGIN 2 */
	GPIO_Init();
	DAC_Init();
	TIM_Init();
	DMA_Init();
	ADC_Init();
	PGA_Init();
	I2C_Init();
	UART_Init();
	Calibrate_Init();
  /* USER CODE END 2 */

  /* Infinite loop */
  while (1)
  {

  }
}

void SystemClock_Config(void)
{
  RCC_OscInitTypeDef RCC_OscInitStruct = {0};
  RCC_ClkInitTypeDef RCC_ClkInitStruct = {0};

  /** Initializes the CPU, AHB and APB busses clocks
  */
  RCC_OscInitStruct.OscillatorType = RCC_OSCILLATORTYPE_HSE;
  RCC_OscInitStruct.HSEState = RCC_HSE_ON;
  RCC_OscInitStruct.HSEPredivValue = RCC_HSE_PREDIV_DIV1;
  RCC_OscInitStruct.HSIState = RCC_HSI_ON;
  RCC_OscInitStruct.PLL.PLLState = RCC_PLL_ON;
  RCC_OscInitStruct.PLL.PLLSource = RCC_PLLSOURCE_HSE;
  RCC_OscInitStruct.PLL.PLLMUL = RCC_PLL_MUL9;
  if (HAL_RCC_OscConfig(&RCC_OscInitStruct) != HAL_OK)
  {
    Error_Handler();
  }
  /** Initializes the CPU, AHB and APB busses clocks
  */
  RCC_ClkInitStruct.ClockType = RCC_CLOCKTYPE_HCLK|RCC_CLOCKTYPE_SYSCLK
                              |RCC_CLOCKTYPE_PCLK1|RCC_CLOCKTYPE_PCLK2;
  RCC_ClkInitStruct.SYSCLKSource = RCC_SYSCLKSOURCE_PLLCLK;
  RCC_ClkInitStruct.AHBCLKDivider = RCC_SYSCLK_DIV1;
  RCC_ClkInitStruct.APB1CLKDivider = RCC_HCLK_DIV2;
  RCC_ClkInitStruct.APB2CLKDivider = RCC_HCLK_DIV1;

  if (HAL_RCC_ClockConfig(&RCC_ClkInitStruct, FLASH_LATENCY_2) != HAL_OK)
  {
    Error_Handler();
  }
}

static void MX_GPIO_Init(void)
{

  /* GPIO Ports Clock Enable */
  __HAL_RCC_GPIOF_CLK_ENABLE();

}

/* USER CODE BEGIN 4 */
static void GPIO_Init(void)
{
	RCC->AHBENR |= 1<<17;				//GPIOA 时钟使能
	RCC->AHBENR |= 1<<18;				//GPIOB 时钟使能
	GPIOA->MODER |= 1<<8;				//PA4 输出模式
	GPIOA->MODER |= 3<<12;			//PA6	模拟模式
	GPIOA->MODER |= 3<<14;			//PA7 模拟模式
	GPIOB->MODER |= 1<<12;			//PB6	输出模式
	GPIOB->MODER |= 1<<14;			//PB7	输出模式
	GPIOB->MODER |= 1<<16;			//PB8	输出模式
	GPIOB->MODER |= 1<<18;			//PB9	输出模式
	GPIOB->PUPDR |= 1<<12;			//PB6	上拉模式
	GPIOB->PUPDR |= 1<<14;			//PB7	上拉模式
	GPIOB->PUPDR |= 1<<16;			//PB8	上拉模式
	GPIOB->PUPDR |= 1<<18;			//PB9	上拉模式
	GPIOA->AFR[0] |= 13<<24;		//PA6 复用使能
}
static void DMA_Init(void)
{
	RCC->AHBENR |= 1<<0; 									//DMA1 时钟使能
	DMA1_Channel2->CPAR = (uint32_t)&ADC2->DR;							//设置外设地址
	DMA1_Channel2->CMAR = (uint32_t)&ADC2ConvertedVault;		//设置内存地址
	DMA1_Channel2->CNDTR = 64;						//每周期传输数据量
	DMA1_Channel2->CCR &= 0<<4;						//设置传输方向
	DMA1_Channel2->CCR |= 1<<5;						//开启循环模式
	DMA1_Channel2->CCR |= 1<<7;						//内存递增模式
	DMA1_Channel2->CCR |= 1<<8;						//外设数据16位
	DMA1_Channel2->CCR |= 1<<10;					//DMA 存储数据16位
	DMA1_Channel2->CCR |= 3<<12;					//通道设置为最高优先级
	DMA1_Channel2->CCR |= 1<<0;						//DMA1 通道2使能
}
static void ADC_Init(void)
{
	RCC->AHBENR |= 1<<28; 			//ADC2 时钟使能
	RCC->AHBRSTR |= 1<<28;			//ADC2 复位
	RCC->AHBRSTR &= 0<<28;			//ADC2 复位结束
	ADC1_2_COMMON->CCR |= 3<<16;//ADC2 时钟设置为 HCLK/4
	ADC2->CFGR |= 1<<1;					//DMA 循环模式
	ADC2->CFGR |= 1<<13;				//ADC2 循环转换模式
	ADC2->SQR1 &= 0<<0;					//ADC2 总通道数设为1
	ADC2->SQR1 |=	3<<6;					//ADC2 通道3使能
	ADC2->CR |= 1<<0;						//ADC2 转换使能
	ADC2->CFGR |= 1<<0;					//DMA 信号功能使能
	ADC2->CR |= 1<<2;						//规则通道转换使能
}
static void TIM_Init(void)
{
	RCC->APB1ENR |= 1<<0;				//TIM2 时钟使能
	TIM2->ARR = 2000-1;					//重装载值
	TIM2->PSC = 36000-1;				//预分频系数
	TIM2->DIER = 1<<0;					//TIM2 允许更新中断使能
	TIM2->CR1 |= 1<<0;					//TIM2 使能
	NVIC_EnableIRQ(TIM2_IRQn);	//TIM2 中断使能

	RCC->APB1ENR |= 1<<1;				//TIM3 时钟使能
	TIM3->ARR = 200-1;					//重装载值
	TIM3->PSC = 72-1;						//预分频系数
	TIM3->DIER = 1<<0;					//TIM3 允许更新中断使能
	TIM3->CR1 |= 1<<0;					//TIM3 使能
	NVIC_EnableIRQ(TIM3_IRQn);	//TIM3 中断使能
}
static void PGA_Init(void)
{
	RCC->APB2ENR |= 1<<0;				//SYSCFG 时钟使能
	OPAMP2->CSR |= 3<<2;				//PA7 设为OPAMP2非反相输入端
	OPAMP2->CSR |= 3<<5;				//设置为跟随模式
	OPAMP2->CSR |= 1<<0;				//OPAMP2  使能
}
static void DAC_Init(void)
{
	RCC->APB1ENR |= 1<<29;			//DAC1 时钟使能
	DAC1->CR |= 1<<1;						//DAC1 缓存区使能
	DAC1->CR |= 1<<0;						//DAC1 通道1使能
}
static void Calibrate_Init(void)
{
	Avg_H_Count = 0;
	Avg_L_Count = 0;
	Actual_Gain = 0;
	Actual_Offset = 0;
	GPIOB->BSRR |= 1<<7;				//校准指示灯使能
}
static void UART_Init(void)
{
	USART1->CR1 |= 1<<0;	//USART使能
}
void Calibrate(void)
{
	int mk_cali = 0;						//辅助校准值生成计数
	uint32_t	Sum_H_Count = 0;	//90%样本和值
	uint32_t	Sum_L_Count = 0;	//0%样本和值

	if(Calibrate_Status != 1)		//若未校准则开始校准
		{
			if(ADC2->DR<1229)				//判断是否为低电平
			{
				for(mk_cali=0;mk_cali<64;mk_cali++)
					Sum_L_Count += ADC2ConvertedVault[mk_cali];
				Avg_L_Count = Sum_L_Count >> 6;
				Sum_L_Count = 0;
			}
			if(ADC2->DR>3277)				//判断是否为高电平
			{
				for(mk_cali=0;mk_cali<64;mk_cali++)
					Sum_H_Count += ADC2ConvertedVault[mk_cali];
				Avg_H_Count = Sum_H_Count >> 6;
				Sum_H_Count = 0;
			}
		}

		if(TimeBase == 5)
		{
			if(Calibrate_Status != 1 && (Avg_H_Count-Avg_L_Count)>1000)												//消除干扰信号
			{
				Actual_Gain = (HIGH_IDEAL_COUNT - LOW_IDEAL_COUNT)/(Avg_H_Count-Avg_L_Count);		//计算实际增益系数
				if(LOW_IDEAL_COUNT<Avg_L_Count)
					Actual_Offset = Avg_L_Count*Actual_Gain - LOW_IDEAL_COUNT;
				if(HIGH_IDEAL_COUNT>Avg_H_Count)
					Actual_Offset = HIGH_IDEAL_COUNT - Avg_H_Count*Actual_Gain;										//计算偏置
				Calibrate_Status = 1;																														//开机5s后 置位校准标志
				DAC1->DHR12R1 = OverSampling_15bit;																							//校准完成后跟随ADC2
			}
			TimeBase = 0;
			GPIOB->BSRR |= 1<<7;		//校准指示灯使能
		}
}
void LED(void)
{
		if(Calibrate_Status == 1 || TimeBase == 4)
			GPIOB->BRR |= 1<<7;								//校准指示灯除能

		if(ADC2->DR>3277)
		{
			GPIOB->BSRR |= 1<<9;							//高电平指示灯使能
			GPIOB->BRR |= 1<<8;
		}

		if(ADC2->DR<1229)
		{
			GPIOB->BSRR |= 1<<8;							//低电平指示灯使能
			GPIOB->BRR |= 1<<9;
		}
}
void PGA(void)
{
	if(ADC2->DR>3277)
		{
			if(OPAMP2->CSR == 0x1078404D)			//X4模式
				OPAMP2->CSR = 0x1078004D;				//X2模式
			else
			{
				if(OPAMP2->CSR == 0x1078004D)		//X2模式
					OPAMP2->CSR = 0x1078006D;			//X1模式
			}
		}

		if(ADC2->DR<1229)
		{
			if(OPAMP2->CSR == 0x1078006D)			//X1模式
				OPAMP2->CSR = 0x1078004D;				//X2模式
			else
			{
				if(OPAMP2->CSR == 0x1078004D)		//X2模式
					OPAMP2->CSR = 0x1078404D;			//X4模式
			}
		}
}
void ADC2_Channel3(void)
{
	int mk_15bit = 0;						//15位过采样值生成计数
	int	mk_20bit;								//20位过采样值生成计数
	uint32_t sum_15bit = 0;			//15位过采样值生成求和
	uint32_t sum_20bit = 0;			//20位过采样值生成求和

	ADC2->CR |= 1<<2;						//ADC2 规则通道转换使能
	if((DMA1->ISR&(1<<5)) == 1)	//判断DMA是否传输完成
		ADC2->CR |= 1<<4;					//ADC2 规则通道转化停止

	if(Calibrate_Status == 1)		//校准完成后计算15bit数据
		{
			for(mk_15bit=0;mk_15bit<64;mk_15bit++)
				sum_15bit += ADC2ConvertedVault[mk_15bit]*Actual_Gain+Actual_Offset;
			OverSampling_15bit = sum_15bit >> 6;
			sum_15bit = 0;
		}

	if(TimeBase == 5 && Calibrate_Status == 1)		//校准完成后每5s计算20bit数据
		{
			for(mk_20bit=0;mk_20bit<1024;mk_20bit++)
				sum_20bit += OverSampling_15bit;
			OverSampling_20bit = sum_20bit >> 10;
			TimeBase = 0;						//时基清零
	 	}
}
void DAC1_Channel1(void)
{
	if(TimeBase == 1 && Calibrate_Status != 1)
			DAC1->DHR12R1 = LOW_IDEAL_COUNT;	//开机1S后 DAC输出0%参考电压
	if(TimeBase == 3 && Calibrate_Status != 1)
		DAC1->DHR12R1 = HIGH_IDEAL_COUNT;		//开机3S后 DAC输出90%参考电压
}
void TIM2_IRQHandler(void)
{
	if(TIM2->SR&1)							//判断是否溢出
	{
		DAC1_Channel1();
		TimeBase++;
	}
	TIM2->SR &= 0<<0;						//清除中断标志
}
void TIM3_IRQHandler(void)
{
	if(TIM3->SR&1)							//判断是否溢出
	{
		ADC2_Channel3();
		LED();										//LED 控制函数
		Calibrate();							//校准功能函数
//		PGA();
	}
	TIM3->SR &= 0<<0;						//清除中断标志
}
/* USER CODE END 4 */

void Error_Handler(void)
{
}

/************************ (C) COPYRIGHT STMicroelectronics *****END OF FILE****/
